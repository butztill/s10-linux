## kernel/overlay/drivers/misc/samsung-mcu-ipc/Kconfig
```kconfig
# SPDX-License-Identifier: GPL-2.0-or-later
config SAMSUNG_EXYNOS9820_MCU_IPC
	tristate "Samsung Exynos 9820 CP mailbox (S10)"
	depends on ARCH_EXYNOS && OF
	default n
	help
	  Support the Samsung MCU_IPC mailbox used by the Exynos 9820 CP on
	  Galaxy S10-family devices. This is the legacy Samsung mailbox API
	  consumed by the S5000AP SIPC modem stack; it is not a generic mailbox
	  controller driver.

	  Keep this disabled unless the matching S10 CP mailbox node and its
	  interrupt mapping have been reviewed in the device tree. Enabling this
	  driver clears AP-generated pending mailbox interrupts when it probes.
```

## kernel/overlay/drivers/soc/samsung/Kconfig
```kconfig
# SPDX-License-Identifier: GPL-2.0
#
# Samsung SoC drivers
#
menuconfig SOC_SAMSUNG
	bool "Samsung SoC driver support" if COMPILE_TEST

if SOC_SAMSUNG

# There is no need to enable these drivers for ARMv8
config EXYNOS_ASV_ARM
	bool "Exynos ASV ARMv7-specific driver extensions" if COMPILE_TEST
	depends on EXYNOS_CHIPID

config EXYNOS_CHIPID
	tristate "Exynos ChipID controller and ASV driver"
	depends on ARCH_EXYNOS || COMPILE_TEST
	default ARCH_EXYNOS
	select EXYNOS_ASV_ARM if ARM && ARCH_EXYNOS
	select MFD_SYSCON
	select SOC_BUS
	help
	  Support for Samsung Exynos SoC ChipID and Adaptive Supply Voltage.
	  This driver can also be built as module (exynos_chipid).

config EXYNOS_USI
	tristate "Exynos USI (Universal Serial Interface) driver"
	default ARCH_EXYNOS && ARM64
	depends on ARCH_EXYNOS || COMPILE_TEST
	select MFD_SYSCON
	help
	  Enable support for USI block. USI (Universal Serial Interface) is an
	  IP-core found in modern Samsung Exynos SoCs, like Exynos850 and
	  ExynosAutoV9. USI block can be configured to provide one of the
	  following serial protocols: UART, SPI or High Speed I2C.

	  This driver allows one to configure USI for desired protocol, which
	  is usually done in USI node in Device Tree.

config EXYNOS_PMU
	bool "Exynos PMU controller driver" if COMPILE_TEST
	depends on ARCH_EXYNOS || ((ARM || ARM64) && COMPILE_TEST)
	select EXYNOS_PMU_ARM_DRIVERS if ARM && ARCH_EXYNOS
	select MFD_CORE
	select REGMAP_MMIO

# There is no need to enable these drivers for ARMv8
config EXYNOS_PMU_ARM_DRIVERS
	bool "Exynos PMU ARMv7-specific driver extensions" if COMPILE_TEST
	depends on EXYNOS_PMU

config SAMSUNG_PM_CHECK
	bool "S3C2410 PM Suspend Memory CRC"
	depends on PM && (ARCH_S3C64XX || ARCH_S5PV210)
	select CRC32
	help
	  Enable the PM code's memory area checksum over sleep. This option
	  will generate CRCs of all blocks of memory, and store them before
	  going to sleep. The blocks are then checked on resume for any
	  errors.

	  Note, this can take several seconds depending on memory size
	  and CPU speed.

config SAMSUNG_PM_CHECK_CHUNKSIZE
	int "S3C2410 PM Suspend CRC Chunksize (KiB)"
	depends on PM && SAMSUNG_PM_CHECK
	default 64
	help
	  Set the chunksize in Kilobytes of the CRC for checking memory
	  corruption over suspend and resume. A smaller value will mean that
	  the CRC data block will take more memory, but will identify any
	  faults with better precision.

config EXYNOS_REGULATOR_COUPLER
	bool "Exynos SoC Regulator Coupler" if COMPILE_TEST
	depends on ARCH_EXYNOS || COMPILE_TEST

config SAMSUNG_EXYNOS_SMC_ARM64
	tristate "Samsung Exynos ARM64 SMC wrapper"
	depends on ARCH_EXYNOS && ARM64 && HAVE_ARM_SMCCC
	default n
	help
	  Provide Samsung's exynos_smc() wrapper using the generic Arm SMCCC
	  interface. The CP secure-boot path uses this vendor SMC API. Enabling
	  this wrapper does not issue SMC calls by itself.

config SAMSUNG_EXYNOS9820_CP_DIAG
	tristate "Exynos 9820 CP read-only diagnostics"
	depends on ARCH_EXYNOS && ARM64 && SAMSUNG_EXYNOS_SMC_ARM64
	default n
	help
	  Expose read-only CP_CTRL_S and CP_CTRL_NS values through sysfs using
	  Samsung's secure-monitor read service. No secure-monitor call is made
	  at module load; reads happen only when a sysfs attribute is accessed.
	  This driver does not change CP power, reset, firmware, or mailbox state.
endif
```
